/**
 * @cliArgs --board "/ti/boards/LP_EM_CC2340R5" --rtos "freertos" --product "simplelink_lowpower_f3_sdk@7.20.01.10"
 * @versions {"tool":"1.18.0+3266"}
 */

/**
 * Import the modules used in this configuration.
 */
const FreeRTOS    = scripting.addModule("/freertos/FreeRTOS");
const ble         = scripting.addModule("/ti/ble5stack/ble");
const CCFG        = scripting.addModule("/ti/devices/CCFG");
const Display     = scripting.addModule("/ti/display/Display");
const Display1    = Display.addInstance();
const AESCCM      = scripting.addModule("/ti/drivers/AESCCM");
const AESCCM1     = AESCCM.addInstance();
const AESCTRDRBG  = scripting.addModule("/ti/drivers/AESCTRDRBG");
const AESCTRDRBG1 = AESCTRDRBG.addInstance();
const AESECB      = scripting.addModule("/ti/drivers/AESECB");
const AESECB1     = AESECB.addInstance();
const ECDH        = scripting.addModule("/ti/drivers/ECDH");
const ECDH1       = ECDH.addInstance();
const GPIO        = scripting.addModule("/ti/drivers/GPIO", {}, false);
const GPIO1       = GPIO.addInstance();
const GPIO2       = GPIO.addInstance();
const GPIO3       = GPIO.addInstance();
const GPIO4       = GPIO.addInstance();
const GPIO5       = GPIO.addInstance();
const I2C         = scripting.addModule("/ti/drivers/I2C", {}, false);
const I2C1        = I2C.addInstance();
const NVS         = scripting.addModule("/ti/drivers/NVS");
const NVS1        = NVS.addInstance();
const Power       = scripting.addModule("/ti/drivers/Power");
const RNG         = scripting.addModule("/ti/drivers/RNG");
const RNG1        = RNG.addInstance();
const Button      = scripting.addModule("/ti/drivers/apps/Button", {}, false);
const Button1     = Button.addInstance();
const Button2     = Button.addInstance();
const Settings    = scripting.addModule("/ti/posix/freertos/Settings");

/**
 * Write custom configuration values to the imported modules.
 */
FreeRTOS.heapSize       = 0x000044B0;
FreeRTOS.timerStackSize = 0x00000190;
FreeRTOS.idleStackSize  = 0x00000130;

ble.basicBLE                                                   = true;
ble.disDevBySerUuid                                            = true;
ble.numOfAdvSets                                               = 1;
ble.numOfDefAdvSets                                            = 1;
ble.dupFilter                                                  = "SCAN_FLT_DUP_DISABLE";
ble.deviceName                                                 = "Proximity";
ble.maxNumIcallEnabledTasks                                    = 4;
ble.maxNumEntIcall                                             = 7;
ble.connUpdateParamsPeripheral.$name                           = "ti_ble5stack_general_ble_conn_update_params0";
ble.advSet1.$name                                              = "ti_ble5stack_broadcaster_advertisement_set0";
ble.advSet1.advParam1.$name                                    = "ti_ble5stack_broadcaster_advertisement_params0";
ble.advSet1.advData1.$name                                     = "ti_ble5stack_broadcaster_advertisement_data0";
ble.advSet1.advData1.GAP_ADTYPE_16BIT_MORE                     = true;
ble.advSet1.advData1.numOfUUIDs16More                          = 1;
ble.advSet1.advData1.UUID016More                               = 0xFFF0;
ble.advSet1.scanRes1.$name                                     = "ti_ble5stack_broadcaster_advertisement_data1";
ble.advSet1.scanRes1.GAP_ADTYPE_PERIPHERAL_CONN_INTERVAL_RANGE = true;

CCFG.ccfgTemplate.$name = "ti_devices_CCFG_CCFGCC23X0Template0";

Display1.$name                    = "CONFIG_Display_0";
Display1.$hardware                = system.deviceData.board.components.XDS110UART;
Display1.uartBufferSize           = 128;
Display1.uart.$name               = "CONFIG_DISPLAY_UART";
Display1.uart.txPinInstance.$name = "CONFIG_PIN_UART_TX";
Display1.uart.rxPinInstance.$name = "CONFIG_PIN_UART_RX";

AESCCM1.$name = "CONFIG_AESCCM0";

AESCTRDRBG1.$name = "CONFIG_AESCTRDRBG_0";

AESECB1.$name = "CONFIG_AESECB0";

ECDH1.$name = "CONFIG_ECDH0";

GPIO1.$name            = "CONFIG_GPIO_X4_IRQ_0";
GPIO1.pull             = "Pull Down";
GPIO1.interruptTrigger = "Rising Edge";
GPIO1.gpioPin.$assign  = "boosterpack.28";

GPIO2.$name           = "CONFIG_GPIO_X4_EN_0";
GPIO2.mode            = "Output";
GPIO2.gpioPin.$assign = "boosterpack.37";

GPIO3.$name           = "CONFIG_GPIO_X4_CS_0";
GPIO3.gpioPin.$assign = "boosterpack.18";
scripting.suppress("Connected to hardware,@@@.+?@@@ is connected to LaunchPad SPI Bus Chip Select on the CC2340R5 Development Platform\\. Consider selecting it in 'use hardware' above\\. @@@.+?@@@", GPIO3, "gpioPin");

GPIO4.$name     = "CONFIG_GPIO_LEDR";
GPIO4.$hardware = system.deviceData.board.components.LED_RED;

GPIO5.$name     = "CONFIG_GPIO_LEDG";
GPIO5.$hardware = system.deviceData.board.components.LED_GREEN;

I2C1.$name             = "CONFIG_I2C_0";
I2C1.interruptPriority = "1";

NVS1.$name                    = "CONFIG_NVSINTERNAL";
NVS1.internalFlash.$name      = "ti_drivers_nvs_NVSLPF30";
NVS1.internalFlash.regionBase = 0x7C000;
NVS1.internalFlash.regionSize = 0x4000;

RNG.noiseConditioningKeyW3 = 0x8E020CA3;

RNG1.$name = "CONFIG_RNG_0";

Button1.$name     = "CONFIG_BUTTON_0";
Button1.$hardware = system.deviceData.board.components["BTN-1"];

Button2.$name     = "CONFIG_BUTTON_1";
Button2.$hardware = system.deviceData.board.components["BTN-2"];

/**
 * Pinmux solution for unlocked pins/peripherals. This ensures that minor changes to the automatic solver in a future
 * version of the tool will not impact the pinmux you originally saw.  These lines can be completely deleted in order to
 * re-solve from scratch.
 */
Display1.uart.uart.$suggestSolution              = "UART0";
Display1.uart.uart.dmaTxChannel.$suggestSolution = "DMA_CH1";
Display1.uart.uart.dmaRxChannel.$suggestSolution = "DMA_CH0";
Display1.uart.uart.txPin.$suggestSolution        = "boosterpack.4";
Display1.uart.uart.rxPin.$suggestSolution        = "boosterpack.3";
GPIO4.gpioPin.$suggestSolution                   = "boosterpack.39";
GPIO5.gpioPin.$suggestSolution                   = "boosterpack.40";
I2C1.i2c.$suggestSolution                        = "I2C0";
I2C1.i2c.sdaPin.$suggestSolution                 = "boosterpack.10";
I2C1.i2c.sclPin.$suggestSolution                 = "boosterpack.9";
Button1.button.$suggestSolution                  = "boosterpack.13";
Button2.button.$suggestSolution                  = "boosterpack.12";
